## build/zigbee-internal-btz/Kconfig/Kconfig.modules
```kconfig
menu "ncs-zigbee (/home/goodbyte/projects/workspace_zigbee/zigbee-internal-btz/../ncs-zigbee)"
osource "/home/goodbyte/projects/workspace_zigbee/ncs-zigbee/Kconfig"
config ZEPHYR_NCS_ZIGBEE_MODULE
	bool
	default y
endmenu
menu "nrf (/home/goodbyte/projects/workspace_zigbee/nrf)"
osource "/home/goodbyte/projects/workspace_zigbee/nrf/Kconfig.nrf"
config ZEPHYR_NRF_MODULE
	bool
	default y
endmenu
menu "mcuboot (/home/goodbyte/projects/workspace_zigbee/bootloader/mcuboot)"
osource "$(ZEPHYR_MCUBOOT_KCONFIG)"
config ZEPHYR_MCUBOOT_MODULE
	bool
	default y
endmenu
menu "mbedtls (/home/goodbyte/projects/workspace_zigbee/modules/crypto/mbedtls)"
osource "$(ZEPHYR_MBEDTLS_KCONFIG)"
config ZEPHYR_MBEDTLS_MODULE
	bool
	default y
endmenu
menu "oberon-psa-crypto (/home/goodbyte/projects/workspace_zigbee/modules/crypto/oberon-psa-crypto)"
osource "/home/goodbyte/projects/workspace_zigbee/modules/crypto/oberon-psa-crypto/Kconfig.oberon_psa_crypto"
config ZEPHYR_OBERON_PSA_CRYPTO_MODULE
	bool
	default y
endmenu
menu "trusted-firmware-m (/home/goodbyte/projects/workspace_zigbee/modules/tee/tf-m/trusted-firmware-m)"
osource "$(ZEPHYR_TRUSTED_FIRMWARE_M_KCONFIG)"
config ZEPHYR_TRUSTED_FIRMWARE_M_MODULE
	bool
	default y
endmenu
config ZEPHYR_PSA_ARCH_TESTS_MODULE
	bool
	default y
config ZEPHYR_SOC_HWMV1_MODULE
	bool
	default y
menu "cjson (/home/goodbyte/projects/workspace_zigbee/modules/lib/cjson)"
osource "$(ZEPHYR_CJSON_KCONFIG)"
config ZEPHYR_CJSON_MODULE
	bool
	default y
endmenu
menu "azure-sdk-for-c (/home/goodbyte/projects/workspace_zigbee/modules/lib/azure-sdk-for-c)"
osource "$(ZEPHYR_AZURE_SDK_FOR_C_KCONFIG)"
config ZEPHYR_AZURE_SDK_FOR_C_MODULE
	bool
	default y
endmenu
menu "cirrus-logic (/home/goodbyte/projects/workspace_zigbee/modules/hal/cirrus-logic)"
osource "/home/goodbyte/projects/workspace_zigbee/modules/hal/cirrus-logic/Kconfig"
config ZEPHYR_CIRRUS_LOGIC_MODULE
	bool
	default y
endmenu
menu "openthread (/home/goodbyte/projects/workspace_zigbee/modules/lib/openthread)"
osource "$(ZEPHYR_OPENTHREAD_KCONFIG)"
config ZEPHYR_OPENTHREAD_MODULE
	bool
	default y
endmenu
menu "suit-generator (/home/goodbyte/projects/workspace_zigbee/modules/lib/suit-generator)"
osource "/home/goodbyte/projects/workspace_zigbee/modules/lib/suit-generator/ncs/Kconfig"
config ZEPHYR_SUIT_GENERATOR_MODULE
	bool
	default y
endmenu
menu "suit-processor (/home/goodbyte/projects/workspace_zigbee/modules/lib/suit-processor)"
osource "/home/goodbyte/projects/workspace_zigbee/modules/lib/suit-processor/Kconfig"
config ZEPHYR_SUIT_PROCESSOR_MODULE
	bool
	default y
endmenu
menu "memfault-firmware-sdk (/home/goodbyte/projects/workspace_zigbee/modules/lib/memfault-firmware-sdk)"
osource "/home/goodbyte/projects/workspace_zigbee/modules/lib/memfault-firmware-sdk/ports/zephyr/Kconfig"
config ZEPHYR_MEMFAULT_FIRMWARE_SDK_MODULE
	bool
	default y
endmenu
menu "coremark (/home/goodbyte/projects/workspace_zigbee/modules/benchmark/coremark)"
osource "$(ZEPHYR_COREMARK_KCONFIG)"
config ZEPHYR_COREMARK_MODULE
	bool
	default y
endmenu
menu "canopennode (/home/goodbyte/projects/workspace_zigbee/modules/lib/canopennode)"
osource "$(ZEPHYR_CANOPENNODE_KCONFIG)"
config ZEPHYR_CANOPENNODE_MODULE
	bool
	default y
endmenu
menu "chre (/home/goodbyte/projects/workspace_zigbee/modules/lib/chre)"
osource "/home/goodbyte/projects/workspace_zigbee/modules/lib/chre/platform/zephyr/Kconfig"
config ZEPHYR_CHRE_MODULE
	bool
	default y
endmenu
menu "lz4 (/home/goodbyte/projects/workspace_zigbee/modules/lib/lz4)"
osource "$(ZEPHYR_LZ4_KCONFIG)"
config ZEPHYR_LZ4_MODULE
	bool
	default y
endmenu
menu "nanopb (/home/goodbyte/projects/workspace_zigbee/modules/lib/nanopb)"
osource "$(ZEPHYR_NANOPB_KCONFIG)"
config ZEPHYR_NANOPB_MODULE
	bool
	default y
endmenu
config ZEPHYR_TF_M_TESTS_MODULE
	bool
	default y
menu "zscilib (/home/goodbyte/projects/workspace_zigbee/modules/lib/zscilib)"
osource "/home/goodbyte/projects/workspace_zigbee/modules/lib/zscilib/Kconfig.zscilib"
config ZEPHYR_ZSCILIB_MODULE
	bool
	default y
endmenu
menu "cmsis (/home/goodbyte/projects/workspace_zigbee/modules/hal/cmsis)"
osource "$(ZEPHYR_CMSIS_KCONFIG)"
config ZEPHYR_CMSIS_MODULE
	bool
	default y
endmenu
menu "cmsis-dsp (/home/goodbyte/projects/workspace_zigbee/modules/lib/cmsis-dsp)"
osource "$(ZEPHYR_CMSIS_DSP_KCONFIG)"
config ZEPHYR_CMSIS_DSP_MODULE
	bool
	default y
endmenu
menu "cmsis-nn (/home/goodbyte/projects/workspace_zigbee/modules/lib/cmsis-nn)"
osource "$(ZEPHYR_CMSIS_NN_KCONFIG)"
config ZEPHYR_CMSIS_NN_MODULE
	bool
	default y
endmenu
menu "fatfs (/home/goodbyte/projects/workspace_zigbee/modules/fs/fatfs)"
osource "$(ZEPHYR_FATFS_KCONFIG)"
config ZEPHYR_FATFS_MODULE
	bool
	default y
endmenu
menu "hal_nordic (/home/goodbyte/projects/workspace_zigbee/modules/hal/nordic)"
osource "$(ZEPHYR_HAL_NORDIC_KCONFIG)"
config ZEPHYR_HAL_NORDIC_MODULE
	bool
	default y

config ZEPHYR_HAL_NORDIC_MODULE_BLOBS
	bool
endmenu
menu "hal_st (/home/goodbyte/projects/workspace_zigbee/modules/hal/st)"
osource "$(ZEPHYR_HAL_ST_KCONFIG)"
config ZEPHYR_HAL_ST_MODULE
	bool
	default y
endmenu
config ZEPHYR_HAL_WURTHELEKTRONIK_MODULE
	bool
	default y
menu "hostap (/home/goodbyte/projects/workspace_zigbee/modules/lib/hostap)"
osource "$(ZEPHYR_HOSTAP_KCONFIG)"
config ZEPHYR_HOSTAP_MODULE
	bool
	default y
endmenu
config ZEPHYR_LIBMETAL_MODULE
	bool
	default y
menu "liblc3 (/home/goodbyte/projects/workspace_zigbee/modules/lib/liblc3)"
osource "$(ZEPHYR_LIBLC3_KCONFIG)"
config ZEPHYR_LIBLC3_MODULE
	bool
	default y
endmenu
menu "littlefs (/home/goodbyte/projects/workspace_zigbee/modules/fs/littlefs)"
osource "$(ZEPHYR_LITTLEFS_KCONFIG)"
config ZEPHYR_LITTLEFS_MODULE
	bool
	default y
endmenu
menu "loramac-node (/home/goodbyte/projects/workspace_zigbee/modules/lib/loramac-node)"
osource "$(ZEPHYR_LORAMAC_NODE_KCONFIG)"
config ZEPHYR_LORAMAC_NODE_MODULE
	bool
	default y
endmenu
menu "lvgl (/home/goodbyte/projects/workspace_zigbee/modules/lib/gui/lvgl)"
osource "/home/goodbyte/projects/workspace_zigbee/modules/lib/gui/lvgl/Kconfig"
config ZEPHYR_LVGL_MODULE
	bool
	default y
endmenu
config ZEPHYR_MIPI_SYS_T_MODULE
	bool
	default y
menu "nrf_wifi (/home/goodbyte/projects/workspace_zigbee/modules/lib/nrf_wifi)"
osource "$(ZEPHYR_NRF_WIFI_KCONFIG)"
config ZEPHYR_NRF_WIFI_MODULE
	bool
	default y

config ZEPHYR_NRF_WIFI_MODULE_BLOBS
	bool
endmenu
config ZEPHYR_OPEN_AMP_MODULE
	bool
	default y
menu "picolibc (/home/goodbyte/projects/workspace_zigbee/modules/lib/picolibc)"
osource "/home/goodbyte/projects/workspace_zigbee/modules/lib/picolibc/zephyr/Kconfig"
config ZEPHYR_PICOLIBC_MODULE
	bool
	default y
endmenu
menu "segger (/home/goodbyte/projects/workspace_zigbee/modules/debug/segger)"
osource "$(ZEPHYR_SEGGER_KCONFIG)"
config ZEPHYR_SEGGER_MODULE
	bool
	default y
endmenu
config ZEPHYR_TINYCRYPT_MODULE
	bool
	default y
menu "uoscore-uedhoc (/home/goodbyte/projects/workspace_zigbee/modules/lib/uoscore-uedhoc)"
osource "$(ZEPHYR_UOSCORE_UEDHOC_KCONFIG)"
config ZEPHYR_UOSCORE_UEDHOC_MODULE
	bool
	default y
endmenu
menu "zcbor (/home/goodbyte/projects/workspace_zigbee/modules/lib/zcbor)"
osource "$(ZEPHYR_ZCBOR_KCONFIG)"
config ZEPHYR_ZCBOR_MODULE
	bool
	default y
endmenu
menu "nrfxlib (/home/goodbyte/projects/workspace_zigbee/nrfxlib)"
osource "/home/goodbyte/projects/workspace_zigbee/nrfxlib/Kconfig.nrfxlib"
config ZEPHYR_NRFXLIB_MODULE
	bool
	default y
endmenu
config ZEPHYR_NRF_HW_MODELS_MODULE
	bool
	default y
menu "connectedhomeip (/home/goodbyte/projects/workspace_zigbee/modules/lib/matter)"
osource "/home/goodbyte/projects/workspace_zigbee/modules/lib/matter/config/nrfconnect/chip-module/Kconfig"
config ZEPHYR_CONNECTEDHOMEIP_MODULE
	bool
	default y
endmenu
```

## build/zigbee-internal-btz/Kconfig/Kconfig.shield
```kconfig
osource "/home/goodbyte/projects/workspace_zigbee/boards/shields/*/Kconfig.shield"
osource "/home/goodbyte/projects/workspace_zigbee/nrf/boards/shields/*/Kconfig.shield"
```

## build/zigbee-internal-btz/Kconfig/arch/Kconfig
```kconfig
# Load Zephyr Arch Kconfig descriptions.
osource "/home/goodbyte/projects/workspace_zigbee/zephyr/arch/x86/Kconfig"
osource "/home/goodbyte/projects/workspace_zigbee/zephyr/arch/xtensa/Kconfig"
osource "/home/goodbyte/projects/workspace_zigbee/zephyr/arch/sparc/Kconfig"
osource "/home/goodbyte/projects/workspace_zigbee/zephyr/arch/riscv/Kconfig"
osource "/home/goodbyte/projects/workspace_zigbee/zephyr/arch/posix/Kconfig"
osource "/home/goodbyte/projects/workspace_zigbee/zephyr/arch/nios2/Kconfig"
osource "/home/goodbyte/projects/workspace_zigbee/zephyr/arch/mips/Kconfig"
osource "/home/goodbyte/projects/workspace_zigbee/zephyr/arch/arm64/Kconfig"
osource "/home/goodbyte/projects/workspace_zigbee/zephyr/arch/arm/Kconfig"
osource "/home/goodbyte/projects/workspace_zigbee/zephyr/arch/arc/Kconfig"
```

## build/zigbee-internal-btz/Kconfig/boards/Kconfig.BTZ_EndDevice
```kconfig
# Load board Kconfig descriptions.
osource "/home/goodbyte/projects/workspace_zigbee/boards/goodbyte/BTZ_EndDevice/Kconfig.BTZ_EndDevice"
```

## build/zigbee-internal-btz/Kconfig/boards/Kconfig.defconfig
```kconfig
# Load Zephyr board defconfig descriptions.
osource "/home/goodbyte/projects/workspace_zigbee/boards/goodbyte/BTZ_EndDevice/Kconfig.defconfig"
```
