## build/zigbee-internal-btz/Kconfig/soc/Kconfig
```kconfig
# Load Zephyr SoC Kconfig descriptions.
osource "/home/goodbyte/projects/workspace_zigbee/zephyr/soc/xlnx/zynqmp/Kconfig"
osource "/home/goodbyte/projects/workspace_zigbee/zephyr/soc/xlnx/zynq7000/Kconfig"
osource "/home/goodbyte/projects/workspace_zigbee/zephyr/soc/xen/Kconfig"
osource "/home/goodbyte/projects/workspace_zigbee/zephyr/soc/ti/simplelink/Kconfig"
osource "/home/goodbyte/projects/workspace_zigbee/zephyr/soc/ti/lm3s6965/Kconfig"
osource "/home/goodbyte/projects/workspace_zigbee/zephyr/soc/ti/k3/Kconfig"
osource "/home/goodbyte/projects/workspace_zigbee/zephyr/soc/telink/tlsr/Kconfig"
osource "/home/goodbyte/projects/workspace_zigbee/zephyr/soc/starfive/jh71xx/Kconfig"
osource "/home/goodbyte/projects/workspace_zigbee/zephyr/soc/st/stm32/Kconfig"
osource "/home/goodbyte/projects/workspace_zigbee/zephyr/soc/snps/qemu_arc/Kconfig"
osource "/home/goodbyte/projects/workspace_zigbee/zephyr/soc/snps/nsim/arc_v/Kconfig"
osource "/home/goodbyte/projects/workspace_zigbee/zephyr/soc/snps/nsim/arc_classic/Kconfig"
osource "/home/goodbyte/projects/workspace_zigbee/zephyr/soc/snps/hsdk4xd/Kconfig"
osource "/home/goodbyte/projects/workspace_zigbee/zephyr/soc/snps/hsdk/Kconfig"
osource "/home/goodbyte/projects/workspace_zigbee/zephyr/soc/snps/emsk/Kconfig"
osource "/home/goodbyte/projects/workspace_zigbee/zephyr/soc/snps/emsdp/Kconfig"
osource "/home/goodbyte/projects/workspace_zigbee/zephyr/soc/snps/arc_iot/Kconfig"
osource "/home/goodbyte/projects/workspace_zigbee/zephyr/soc/silabs/Kconfig"
osource "/home/goodbyte/projects/workspace_zigbee/zephyr/soc/sifive/sifive_freedom/Kconfig"
osource "/home/goodbyte/projects/workspace_zigbee/zephyr/soc/sensry/Kconfig"
osource "/home/goodbyte/projects/workspace_zigbee/zephyr/soc/rockchip/Kconfig"
osource "/home/goodbyte/projects/workspace_zigbee/zephyr/soc/renode/riscv_virtual/Kconfig"
osource "/home/goodbyte/projects/workspace_zigbee/zephyr/soc/renode/cortex_r8_virtual/Kconfig"
osource "/home/goodbyte/projects/workspace_zigbee/zephyr/soc/renesas/smartbond/Kconfig"
osource "/home/goodbyte/projects/workspace_zigbee/zephyr/soc/renesas/rzt2m/Kconfig"
osource "/home/goodbyte/projects/workspace_zigbee/zephyr/soc/renesas/rcar/Kconfig"
osource "/home/goodbyte/projects/workspace_zigbee/zephyr/soc/renesas/ra/Kconfig"
osource "/home/goodbyte/projects/workspace_zigbee/zephyr/soc/raspberrypi/Kconfig"
osource "/home/goodbyte/projects/workspace_zigbee/zephyr/soc/quicklogic/eos_s3/Kconfig"
osource "/home/goodbyte/projects/workspace_zigbee/zephyr/soc/qemu/virt_riscv/Kconfig"
osource "/home/goodbyte/projects/workspace_zigbee/zephyr/soc/qemu/malta/Kconfig"
osource "/home/goodbyte/projects/workspace_zigbee/zephyr/soc/openisa/rv32m1/Kconfig"
osource "/home/goodbyte/projects/workspace_zigbee/zephyr/soc/nxp/s32/Kconfig"
osource "/home/goodbyte/projects/workspace_zigbee/zephyr/soc/nxp/rw/Kconfig"
osource "/home/goodbyte/projects/workspace_zigbee/zephyr/soc/nxp/mcx/Kconfig"
osource "/home/goodbyte/projects/workspace_zigbee/zephyr/soc/nxp/lpc/Kconfig"
osource "/home/goodbyte/projects/workspace_zigbee/zephyr/soc/nxp/layerscape/Kconfig"
osource "/home/goodbyte/projects/workspace_zigbee/zephyr/soc/nxp/kinetis/Kconfig"
osource "/home/goodbyte/projects/workspace_zigbee/zephyr/soc/nxp/imxrt/Kconfig"
osource "/home/goodbyte/projects/workspace_zigbee/zephyr/soc/nxp/imx/Kconfig"
osource "/home/goodbyte/projects/workspace_zigbee/zephyr/soc/nuvoton/numicro/Kconfig"
osource "/home/goodbyte/projects/workspace_zigbee/zephyr/soc/nuvoton/numaker/Kconfig"
osource "/home/goodbyte/projects/workspace_zigbee/zephyr/soc/nuvoton/npcx/Kconfig"
osource "/home/goodbyte/projects/workspace_zigbee/zephyr/soc/nuvoton/npcm/Kconfig"
osource "/home/goodbyte/projects/workspace_zigbee/zephyr/soc/nordic/Kconfig"
osource "/home/goodbyte/projects/workspace_zigbee/zephyr/soc/neorv32/Kconfig"
osource "/home/goodbyte/projects/workspace_zigbee/zephyr/soc/native/inf_clock/Kconfig"
osource "/home/goodbyte/projects/workspace_zigbee/zephyr/soc/microchip/miv/Kconfig"
osource "/home/goodbyte/projects/workspace_zigbee/zephyr/soc/microchip/mec/Kconfig"
osource "/home/goodbyte/projects/workspace_zigbee/zephyr/soc/mediatek/mtk_adsp/Kconfig"
osource "/home/goodbyte/projects/workspace_zigbee/zephyr/soc/lowrisc/opentitan/Kconfig"
osource "/home/goodbyte/projects/workspace_zigbee/zephyr/soc/litex/litex_vexriscv/Kconfig"
osource "/home/goodbyte/projects/workspace_zigbee/zephyr/soc/ite/ec/Kconfig"
osource "/home/goodbyte/projects/workspace_zigbee/zephyr/soc/intel/raptor_lake/Kconfig"
osource "/home/goodbyte/projects/workspace_zigbee/zephyr/soc/intel/lakemont/Kconfig"
osource "/home/goodbyte/projects/workspace_zigbee/zephyr/soc/intel/intel_socfpga_std/Kconfig"
osource "/home/goodbyte/projects/workspace_zigbee/zephyr/soc/intel/intel_socfpga/Kconfig"
osource "/home/goodbyte/projects/workspace_zigbee/zephyr/soc/intel/intel_niosv/Kconfig"
osource "/home/goodbyte/projects/workspace_zigbee/zephyr/soc/intel/intel_ish/Kconfig"
osource "/home/goodbyte/projects/workspace_zigbee/zephyr/soc/intel/intel_adsp/Kconfig"
osource "/home/goodbyte/projects/workspace_zigbee/zephyr/soc/intel/elkhart_lake/Kconfig"
osource "/home/goodbyte/projects/workspace_zigbee/zephyr/soc/intel/atom/Kconfig"
osource "/home/goodbyte/projects/workspace_zigbee/zephyr/soc/intel/apollo_lake/Kconfig"
osource "/home/goodbyte/projects/workspace_zigbee/zephyr/soc/intel/alder_lake/Kconfig"
osource "/home/goodbyte/projects/workspace_zigbee/zephyr/soc/infineon/cat3/Kconfig"
osource "/home/goodbyte/projects/workspace_zigbee/zephyr/soc/infineon/cat1b/Kconfig"
osource "/home/goodbyte/projects/workspace_zigbee/zephyr/soc/infineon/cat1a/Kconfig"
osource "/home/goodbyte/projects/workspace_zigbee/zephyr/soc/gd/gd32/Kconfig"
osource "/home/goodbyte/projects/workspace_zigbee/zephyr/soc/gaisler/leon3/Kconfig"
osource "/home/goodbyte/projects/workspace_zigbee/zephyr/soc/gaisler/gr716a/Kconfig"
osource "/home/goodbyte/projects/workspace_zigbee/zephyr/soc/espressif/Kconfig"
osource "/home/goodbyte/projects/workspace_zigbee/zephyr/soc/ene/kb1200/Kconfig"
osource "/home/goodbyte/projects/workspace_zigbee/zephyr/soc/efinix/sapphire/Kconfig"
osource "/home/goodbyte/projects/workspace_zigbee/zephyr/soc/cdns/xtensa_sample_controller/Kconfig"
osource "/home/goodbyte/projects/workspace_zigbee/zephyr/soc/cdns/dc233c/Kconfig"
osource "/home/goodbyte/projects/workspace_zigbee/zephyr/soc/brcm/bcmvk/Kconfig"
osource "/home/goodbyte/projects/workspace_zigbee/zephyr/soc/brcm/bcm2712/Kconfig"
osource "/home/goodbyte/projects/workspace_zigbee/zephyr/soc/brcm/bcm2711/Kconfig"
osource "/home/goodbyte/projects/workspace_zigbee/zephyr/soc/atmel/sam0/Kconfig"
osource "/home/goodbyte/projects/workspace_zigbee/zephyr/soc/atmel/sam/Kconfig"
osource "/home/goodbyte/projects/workspace_zigbee/zephyr/soc/aspeed/Kconfig"
osource "/home/goodbyte/projects/workspace_zigbee/zephyr/soc/arm/Kconfig"
osource "/home/goodbyte/projects/workspace_zigbee/zephyr/soc/arm/beetle/Kconfig"
osource "/home/goodbyte/projects/workspace_zigbee/zephyr/soc/andestech/Kconfig"
osource "/home/goodbyte/projects/workspace_zigbee/zephyr/soc/ambiq/Kconfig"
osource "/home/goodbyte/projects/workspace_zigbee/zephyr/soc/altr/zephyr_nios2f/Kconfig"
osource "/home/goodbyte/projects/workspace_zigbee/zephyr/soc/altr/qemu_nios2/Kconfig"
osource "/home/goodbyte/projects/workspace_zigbee/zephyr/soc/adi/max32/Kconfig"
```
