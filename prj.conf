## Kconfig
```
# Parametry aplikacji sterowane build-time (-DCONFIG_...=<wartosc>).
#
# Pola serii w board-power-test (zakladka Zigbee) odpowiadaja tym symbolom:
#
#   Send interval (T)    -> CONFIG_ZB_SEND_INTERVAL_S
#   Long-poll interval   -> CONFIG_ZB_POLL_INTERVAL_S
#
# Keepalive zostaje na stale w kodzie (60 s, main.c), wiec nie ma go tutaj.
#
# Wartosci domyslne = dzisiejsze zachowanie kodu, wiec build bez zadnej
# flagi daje ten sam obraz co dotad.

config ZB_SEND_INTERVAL_S
	int "Send interval T - co ile sekund wysylamy raport [s]"
	default 20
	range 1 4200
	help
	  Okres wysylania ZCL Report Attribute do koordynatora. To jest "T"
	  z modelu I_avg(T) = E_report/T + I_sleep.

	  Gorny limit 4200 s wynika z ZB_MILLISECONDS_TO_BEACON_INTERVAL:
	  makro mnozy ms x 1000 w 32-bitowym zb_time_t, wiec ok. 4294 s to
	  granica przepelnienia.

config ZB_POLL_INTERVAL_S
	int "Long-poll interval - co ile ED odpytuje rodzica [s]"
	default 3600
	range 1 4200
	help
	  macDataPollInterval: co tyle sekund radio budzi sie, zeby zapytac
	  rodzica o zalegle wiadomosci. Kazde takie wybudzenie kosztuje prad,
	  nawet gdy nie ma zadnych danych do odebrania.

config ZB_DEEP_SLEEP
	bool "Po wyslaniu raportu wejdz w System OFF (reboot co cykl)"
	default n
	select POWEROFF
	help
	  Domyslnie (n) urzadzenie spi w System ON: RAM i stos ZBOSS zyja,
	  miedzy raportami leci tylko poll. Wlaczone (y) - po wyslaniu raportu
	  uzbraja budzik GRTC na ZB_SEND_INTERVAL_S i wchodzi w System OFF.

	  Wybudzenie to PELNY RESET: RAM znika, main() startuje od zera, stos
	  ZBOSS wstaje na nowo i dolacza do sieci ponownie (sygnal
	  ZB_BDB_SIGNAL_DEVICE_REBOOT, klucze czytane z ZBOSS NVRAM).

	  Prad snu spada o rzad wielkosci, ale kazdy cykl placi za reboot
	  i ponowne dolaczenie. Przy krotkich T wychodzi DROZEJ niz System ON;
	  sens ma dopiero przy rzadkich raportach. Zeby znalezc punkt
	  przeciecia, zmierz oba warianty przy tych samych T.

	  UWAGA: sen musi byc krotszy niz ED aging timeout rodzica
	  (ED_AGING_TIMEOUT_256MIN = 15360 s), inaczej rodzic wyrzuci dziecko
	  i kazde wybudzenie bedzie pelnym dolaczaniem od zera, nie rebootem.

config ZB_DEEP_SLEEP_SETTLE_MS
	int "Ile czekac po wyslaniu raportu przed System OFF [ms]"
	default 1000
	range 50 10000
	depends on ZB_DEEP_SLEEP
	help
	  ZB_ZCL_SEND_COMMAND_* tylko KOLEJKUJE ramke - wyjscie na antene
	  dzieje sie pozniej, w watku ZBOSS. Natychmiastowy sys_poweroff()
	  uciolby transmisje. Ten odstep daje stosowi czas na nadanie.

source "Kconfig.zephyr"
```

## prj.conf
```kconfig
CONFIG_ZIGBEE_ROLE_END_DEVICE=y
CONFIG_ZIGBEE_ADD_ON=y
CONFIG_ZIGBEE_APP_UTILS=y

# Low power
CONFIG_PM=y
CONFIG_PM_DEVICE=y
# CONFIG_PM_DEVICE_RUNTIME=y          # i2c30 ma zephyr,pm-device-runtime-auto
CONFIG_RAM_POWER_DOWN_LIBRARY=y
CONFIG_LOG=y
CONFIG_LOG_MODE_DEFERRED=y

# Czujniki
CONFIG_I2C=y
CONFIG_SENSOR=y
CONFIG_BMI270=y
# CONFIG_BMI270_TRIGGER_GLOBAL_THREAD=y

# Regulator szyny czujników
CONFIG_REGULATOR=y
CONFIG_REGULATOR_FIXED=y

CONFIG_NET_IPV6=n
CONFIG_NET_IP_ADDR_CHECK=n
CONFIG_NET_UDP=n

# do pomiarów prądu — patrz snippet low_power w samplu light_switch
# CONFIG_SERIAL=n
# CONFIG_CONSOLE=n
# CONFIG_LOG=n

CONFIG_LOG_BUFFER_SIZE=4096

# main() was overflowing its default 2048B stack once immediate-mode
# logging + DBG-level I2C/sensor traces were enabled, causing a silent
# reset right after the sts4x i2c_read_dt() call.
CONFIG_MAIN_STACK_SIZE=8192
CONFIG_STACK_SENTINEL=y

# crc8() (sts4x checksum check in measure_and_report) lives in Zephyr's
# lib/crc, which is only compiled when CONFIG_CRC=y. Without it the header
# still declares crc8, so it fails at link time, not compile time.
CONFIG_CRC=y
```

## boards/BTZ_EndDevice_nrf54l15_cpuapp.overlay
```dts
/*
 * The board devicetree (boards/goodbyte/BTZ_EndDevice/BTZ_EndDevice_nrf54l15_cpuapp.dts)
 * disables every I2C sensor node. Re-enable the ones this app uses here instead of
 * editing the shared board files, which the other projects in the workspace also use.
 *
 * bmi270 must be "okay" or the Zephyr sensor driver is never instantiated, so
 * DEVICE_DT_GET(DT_NODELABEL(bmi270)) yields a device that can never become ready.
 * sts4x does NOT need this - measure_and_report talks to it with raw i2c_write_dt/
 * i2c_read_dt via I2C_DT_SPEC_GET, which only needs the node's reg/bus properties
 * and ignores status. It is left disabled so no unused sts4x driver is built in.
 */

/*
 * The BMI270 driver uploads its ~8 kB config blob at init in 256-byte bursts,
 * issued as a two-part i2c write (1 register byte + 256 data bytes). The nRF
 * TWIM driver cannot chain those into one EasyDMA transfer, so it copies them
 * into its internal concat buffer, which defaults to 16 bytes:
 *   <err> i2c_nrfx_twim: Need to use the internal driver buffer but its size
 *   is insufficient (1 + 256 > 16)
 * The upload then fails, bmi270's init returns an error, and device_is_ready()
 * stays false forever. 264 = 1 + 256, rounded up to a word multiple.
 */
/*
 * sensor_pwr is regulator-boot-on, so regulator_common_init() flips its enable
 * GPIO and then waits exactly startup-delay-us before returning. That property
 * defaulted to 0, so the rail was declared up the instant the pin toggled -
 * while VDD was still ramping and the BMI270 had not finished its power-on
 * reset. The sensor driver (init priority 90) then probed a chip that was not
 * answering yet, so bmi270 init failed on some boots and succeeded on others.
 * 10 ms comfortably covers the BMI270 ~2 ms start-up time plus rail ramp.
 */
&sensor_pwr {
	startup-delay-us = <10000>;
};

&i2c30 {
	zephyr,concat-buf-size = <264>;
};

&bmi270 {
	status = "okay";
};
```

## src/main.c
```c
#include <zboss_api.h> // the Zigbee stack itself (ZBOSS) - joining network, sending packets, etc.
#include <zephyr/kernel.h>  // Zephyr RTOS - gives you k_sleep, threads, etc.
#include "zb_sensor_node.h"
#include <zboss_api_addons.h> // extra helper macros/functions on top of zboss_api.h
#include <zephyr/logging/log.h>
// #include <zephyr/drivers/gpio.h>
#include <zigbee/zigbee_app_utils.h> // Nordic's helper functions (zigbee_enable, sleepy behavior, etc.)
#include <zigbee/zigbee_error_handler.h> // ZB_ERROR_CHECK macro
#include <zb_nrf_platform.h> // zigbee_enable()

#if defined(CONFIG_ZB_DEEP_SLEEP)
#include <zephyr/sys/poweroff.h>              /* sys_poweroff() */
#include <zephyr/drivers/timer/nrf_grtc_timer.h> /* budzik przezywajacy System OFF */

/* System OFF wywolujemy z main(), nie z watku ZBOSS: sys_poweroff() nigdy
 * nie wraca, a watek stosu ma jeszcze dokonczyc nadawanie ramki. Callback
 * alarmu tylko podnosi semafor, main czeka na nim zamiast na K_FOREVER. */
static K_SEM_DEFINE(deep_sleep_sem, 0, 1);
#endif

LOG_MODULE_REGISTER(btz, LOG_LEVEL_INF);

#define LIGHT_BULB_ENDPOINT 10
// #define LED_NODE DT_ALIAS(led0)

#define COORDINATOR_SHORT_ADDR 0x0000
#define COORDINATOR_EP 10
zb_uint16_t coord_short_addr = COORDINATOR_SHORT_ADDR; /* coordinator address we need for communication */

// static const struct gpio_dt_spec led = GPIO_DT_SPEC_GET(LED_NODE, gpios);

struct zb_device_ctx{
    zb_zcl_basic_attrs_ext_t basic_attr;
    zb_zcl_identify_attrs_t identify_attr;
    zb_zcl_on_off_attrs_t on_off_attr;
};

static struct zb_device_ctx dev_ctx;

static void app_clusters_attr_init(void){
    dev_ctx.basic_attr.zcl_version = ZB_ZCL_VERSION;
    dev_ctx.basic_attr.power_source =  ZB_ZCL_BASIC_POWER_SOURCE_BATTERY;
    dev_ctx.identify_attr.identify_time = ZB_ZCL_IDENTIFY_IDENTIFY_TIME_DEFAULT_VALUE;
    dev_ctx.on_off_attr.on_off = ZB_FALSE;
}

/* attribute lists*/
ZB_ZCL_DECLARE_BASIC_ATTRIB_LIST(basic_attrib_list, &dev_ctx.basic_attr.zcl_version, &dev_ctx.basic_attr.power_source);
ZB_ZCL_DECLARE_IDENTIFY_ATTRIB_LIST(identify_attr_list,&dev_ctx.identify_attr.identify_time);
ZB_ZCL_DECLARE_ON_OFF_ATTRIB_LIST(on_off_attr_list, &dev_ctx.on_off_attr.on_off);

/* cluster lists */
ZB_DECLARE_LIGHT_BULB_CLUSTER_LIST(light_bulb_clusters, basic_attrib_list, identify_attr_list, on_off_attr_list);

/* endpoint */
ZB_DECLARE_LIGHT_BULB_EP(light_bulb_ep, LIGHT_BULB_ENDPOINT, light_bulb_clusters);

/* device context */
ZBOSS_DECLARE_DEVICE_CTX_1_EP(light_bulb_ctx, light_bulb_ep);

// static void on_off_set_value(zb_bool_t value){
//     dev_ctx.on_off_attr.on_off = value;
//     if(value){
//         LOG_INF("LED IS OFF!");
//         gpio_pin_set_dt(&led, 1);
//     }
//     else{
//         LOG_INF("LED IS ON!");
//         gpio_pin_set_dt(&led, 0);
//     }
// }

static zb_uint8_t zcl_device_cb(zb_bufid_t bufid){
    zb_zcl_device_callback_param_t *p = ZB_BUF_GET_PARAM(bufid, zb_zcl_device_callback_param_t); /* returns a pointer to the data in the buffer */
    p->status = RET_OK;

    if(p->device_cb_id != ZB_ZCL_SET_ATTR_VALUE_CB_ID){
        return ZB_FALSE;
    }

    // zb_uint16_t cluster_id = p->cb_param.set_attr_value_param.cluster_id;
    // zb_uint16_t attr_id = p->cb_param.set_attr_value_param.attr_id;

    // if(cluster_id == ZB_ZCL_CLUSTER_ID_ON_OFF && attr_id == ZB_ZCL_ATTR_ON_OFF_ON_OFF_ID){
    //     zb_uint8_t value = p->cb_param.set_attr_value_param.values.data8;
    //     if(value){
    //         on_off_set_value(ZB_TRUE);
    //     }
    //     else{
    //         on_off_set_value(ZB_FALSE);
    //     }
    // }
    return ZB_FALSE;
}

static void send_test_report(zb_uint8_t param);

#if defined(CONFIG_ZB_DEEP_SLEEP)
/* Wolane z watku ZBOSS po odczekaniu na nadanie ramki - samo usypianie
 * robi main(), patrz komentarz przy deep_sleep_sem. */
static void request_deep_sleep(zb_uint8_t param)
{
	ARG_UNUSED(param);
	k_sem_give(&deep_sleep_sem);
}
#endif

void zboss_signal_handler(zb_bufid_t bufid){
    zb_zdo_app_signal_hdr_t *sg_p  = NULL;
    zb_zdo_app_signal_type_t  sig  = zb_get_app_signal(bufid, &sg_p);
    zb_ret_t status = ZB_GET_APP_SIGNAL_STATUS(bufid);

    switch(sig){
        case ZB_BDB_SIGNAL_DEVICE_FIRST_START:
            LOG_INF("Joining network for the first time...");
            bdb_start_top_level_commissioning(ZB_BDB_NETWORK_STEERING);
            break;

        case ZB_BDB_SIGNAL_DEVICE_REBOOT:
            zb_zdo_pim_set_long_poll_interval(CONFIG_ZB_POLL_INTERVAL_S * 1000);
            bdb_start_top_level_commissioning(ZB_BDB_NETWORK_STEERING);
            break;

        case ZB_BDB_SIGNAL_STEERING:
            if(status == RET_OK){
                zb_zdo_pim_set_long_poll_interval(CONFIG_ZB_POLL_INTERVAL_S * 1000);
                /* send first report right after joining */
                ZB_SCHEDULE_APP_ALARM_CANCEL(send_test_report, ZB_ALARM_ANY_PARAM);
                ZB_SCHEDULE_APP_ALARM(send_test_report, 0, ZB_MILLISECONDS_TO_BEACON_INTERVAL(1000));
                uint16_t panId = zb_get_pan_id();
                uint8_t channel = zb_get_current_channel();
                uint16_t shortAddr = zb_get_short_address();

                LOG_INF("Joined a network: PAN ID=0x%04X, Channel=%u, Short Addr=0x%04X", panId, channel, shortAddr);
            }
            else{
                /* ZB network unit of time is BI(beacon interval), ZB devices use it to schedule operations. Beacons because zb in built on ieee802.15.4 which measures time in beacon intervals */
                ZB_SCHEDULE_APP_ALARM((zb_callback_t)bdb_start_top_level_commissioning, ZB_BDB_NETWORK_STEERING, ZB_MILLISECONDS_TO_BEACON_INTERVAL(1000)); /* after delay call this function */
            }
            break;

        /* if an end device leaves the zigbee network */
        case ZB_ZDO_SIGNAL_LEAVE:
            LOG_INF("Reconnecting the network...");
            ZB_SCHEDULE_APP_ALARM((zb_callback_t)bdb_start_top_level_commissioning, ZB_BDB_NETWORK_STEERING, ZB_MILLISECONDS_TO_BEACON_INTERVAL(1000)); /* after delay call this function */
            break;

        default:
            ZB_ERROR_CHECK(zigbee_default_signal_handler(bufid));
            break;
    }
    if (bufid) {
        zb_buf_free(bufid);
    }
}

/* builds and sends the frame directly and schedule it in the loop via alarm */
static void send_test_report(zb_uint8_t param)
{
    zb_bufid_t bufid = zb_buf_get_out(); /* free memory buffer */
    if (!bufid) {
        LOG_ERR("No buffer available");
        ZB_SCHEDULE_APP_ALARM(send_test_report, 0, ZB_MILLISECONDS_TO_BEACON_INTERVAL(60000));
        return;
    }

    zb_uint8_t *ptr = ZB_ZCL_START_PACKET(bufid); /* write into that buffer */
    ZB_ZCL_CONSTRUCT_GENERAL_COMMAND_REQ_FRAME_CONTROL_A(ptr, ZB_ZCL_FRAME_DIRECTION_TO_CLI, ZB_ZCL_NOT_MANUFACTURER_SPECIFIC, ZB_ZCL_DISABLE_DEFAULT_RESPONSE); /* writes control byte */
    ZB_ZCL_CONSTRUCT_COMMAND_HEADER(ptr, ZB_ZCL_GET_SEQ_NUM(), ZB_ZCL_CMD_REPORT_ATTRIB); /* the following header bytes, frame is a report attribute cmd */

    zb_uint8_t test_value = ZB_TRUE; /* the const test value */

    ZB_ZCL_PACKET_PUT_DATA16_VAL(ptr, ZB_ZCL_ATTR_ON_OFF_ON_OFF_ID); /* which attribute */
    ZB_ZCL_PACKET_PUT_DATA8(ptr, ZB_ZCL_ATTR_TYPE_BOOL); /* what data type */
    ZB_ZCL_PACKET_PUT_DATA8(ptr, test_value); /* the actual value */

    ZB_ZCL_SEND_COMMAND_SHORT_WITHOUT_ACK(bufid, ptr, coord_short_addr, ZB_APS_ADDR_MODE_16_ENDP_PRESENT, COORDINATOR_EP, LIGHT_BULB_ENDPOINT, ZB_AF_HA_PROFILE_ID, ZB_ZCL_CLUSTER_ID_ON_OFF, NULL, 0);
    LOG_INF("Sent test report"); /* locally we see that frame was sent */
#if defined(CONFIG_ZB_DEEP_SLEEP)
    /* Wariant System OFF: nie planujemy kolejnego raportu - po wybudzeniu
     * program startuje od main() i raport uzbroi sie ponownie po dolaczeniu
     * do sieci. Tu tylko dajemy stosowi czas na nadanie i budzimy main(). */
    ZB_SCHEDULE_APP_ALARM(request_deep_sleep, 0,
                          ZB_MILLISECONDS_TO_BEACON_INTERVAL(CONFIG_ZB_DEEP_SLEEP_SETTLE_MS));
#else
    ZB_SCHEDULE_APP_ALARM(send_test_report, 0, ZB_MILLISECONDS_TO_BEACON_INTERVAL(CONFIG_ZB_SEND_INTERVAL_S * 1000)); /* repeats every CONFIG_ZB_SEND_INTERVAL_S seconds (default 20) */
#endif
}

int main(void){
    LOG_INF("Starting Zigbee Light Bulb (Sleepy End Device)");
    // gpio_pin_configure_dt(&led, GPIO_OUTPUT_INACTIVE); /* configure led gpio as output*/
    
    ZB_ZCL_REGISTER_DEVICE_CB((zb_callback_t)zcl_device_cb); /* tell zboss which function ahould be called as an event handler callback */
    ZB_AF_REGISTER_DEVICE_CTX(&light_bulb_ctx); /* register device context */
    app_clusters_attr_init(); /* attribute init function */
    
    zb_set_ed_timeout(ED_AGING_TIMEOUT_256MIN); /* set end device waiting timeout - if no reaction for 256 minutes -> end device is dead */
    // keepalive timeout should be ≥ poll interval.
    zb_set_keepalive_timeout(ZB_MILLISECONDS_TO_BEACON_INTERVAL(3600000)); /* 60 min - how often the end device tells its parent "I'm still here" */
    zigbee_configure_sleepy_behavior(true); /* enable sleepy behavoir */

    zb_zdo_pim_set_long_poll_interval(CONFIG_ZB_POLL_INTERVAL_S * 1000); /* how often an end device wakes up to poll a parent about a new message (default 30 s) */
    zigbee_enable(); /* enable zigbee */

#if defined(CONFIG_ZB_DEEP_SLEEP)
    /* Czekamy, az raport pojdzie w eter, i gasimy uklad. GRTC budzi po
     * ZB_SEND_INTERVAL_S, a wybudzenie z System OFF to reset - program
     * wraca tutaj od gory main(), nie z tego miejsca. */
    k_sem_take(&deep_sleep_sem, K_FOREVER);

    int err = z_nrf_grtc_wakeup_prepare((uint64_t)CONFIG_ZB_SEND_INTERVAL_S * 1000000ULL);

    if (err < 0) {
        LOG_ERR("Nie udalo sie uzbroic budzika GRTC (%d) - nie usypiam", err);
        k_sleep(K_FOREVER);
    }
    LOG_INF("System OFF na %d s", CONFIG_ZB_SEND_INTERVAL_S);
    sys_poweroff();
#else
    k_sleep(K_FOREVER); /* sleep forever*/
#endif
    return 0;
}
```

## src/zb_sensor_node.h
```c
#define ZB_LIGHT_BULB_DEVICE_ID 0x0100    /* hue app: it's an On/Off Light */

#define ZB_DEVICE_VER_LIGHT_BULB 0

#define ZB_LIGHT_BULB_IN_CLUSTER_NUM 3    /* server: Basic + Identify + On/Off clusters */
#define ZB_LIGHT_BULB_OUT_CLUSTER_NUM 0   /* no out clusters - cluster where you're the client */

/* macro that builds the cluster list */
#define ZB_DECLARE_LIGHT_BULB_CLUSTER_LIST(                      \
    cluster_list_name,                                           \
    basic_attr_list,                                             \
    identify_attr_list,                                          \
    on_off_attr_list                                             \
)zb_zcl_cluster_desc_t cluster_list_name[] =                     \
{                                                                \
    ZB_ZCL_CLUSTER_DESC(                                         \
        ZB_ZCL_CLUSTER_ID_IDENTIFY,                              \
        ZB_ZCL_ARRAY_SIZE(identify_attr_list, zb_zcl_attr_t),    \
        (identify_attr_list),                                    \
        ZB_ZCL_CLUSTER_SERVER_ROLE,                              \
        ZB_ZCL_MANUF_CODE_INVALID                                \
    ),                                                           \
    ZB_ZCL_CLUSTER_DESC(                                         \
        ZB_ZCL_CLUSTER_ID_BASIC,                                 \
        ZB_ZCL_ARRAY_SIZE(basic_attr_list, zb_zcl_attr_t),       \
        (basic_attr_list),                                       \
        ZB_ZCL_CLUSTER_SERVER_ROLE,                              \
        ZB_ZCL_MANUF_CODE_INVALID                                \
    ),                                                           \
    ZB_ZCL_CLUSTER_DESC(                                         \
        ZB_ZCL_CLUSTER_ID_ON_OFF,                                \
        ZB_ZCL_ARRAY_SIZE(on_off_attr_list, zb_zcl_attr_t),      \
        (on_off_attr_list),                                      \
        ZB_ZCL_CLUSTER_SERVER_ROLE,                              \
        ZB_ZCL_MANUF_CODE_INVALID                                \
    )                                                            \
}
/* the result of calling ZB_DECLARE_LIGHT_BULB_CLUSTER_LIST(name, cl1, cl2, cl3) is an array zb_zcl_cluster_desc_t name = {cl1, cl2, cl3} */

ZB_DECLARE_SIMPLE_DESC(3, 0); /* 3 cluster description in one array (basic, identify, on/off)*/

/* ## is a token, macro that generates a type, ## glues two pieces of text together into one identifier */
/* creates a variable to preserve endpoint number, device type, list of clusters */
#define ZB_ZCL_DECLARE_LIGHT_BULB_SIMPLE_DESC(ep_name, ep_id, in_clust_num, out_clust_num) \
					       \
	ZB_AF_SIMPLE_DESC_TYPE(in_clust_num, out_clust_num) simple_desc_##ep_name =	       \
	{										       \
		ep_id,									       \
		ZB_AF_HA_PROFILE_ID,							       \
		ZB_LIGHT_BULB_DEVICE_ID,						       \
		ZB_DEVICE_VER_LIGHT_BULB,						       \
		0,									       \
		in_clust_num,								       \
		out_clust_num,								       \
		         {                                               \
            ZB_ZCL_CLUSTER_ID_BASIC,                    \
            ZB_ZCL_CLUSTER_ID_IDENTIFY,                 \
            ZB_ZCL_CLUSTER_ID_ON_OFF                    \
        }                                               \
    }

/* where ZB_ZCL_DECLARE_LIGHT_BULB_SIMPLE_DESC creates a varibale that has (endpoint number, device type, cluster ID list) */
/* ZB_AF_DECLARE_ENDPOINT_DESC(...) creates a big description of the endpoint */
#define ZB_DECLARE_LIGHT_BULB_EP(ep_name, ep_id, cluster_list)		      \
	ZB_ZCL_DECLARE_LIGHT_BULB_SIMPLE_DESC(ep_name, ep_id,		      \
		ZB_LIGHT_BULB_IN_CLUSTER_NUM, ZB_LIGHT_BULB_OUT_CLUSTER_NUM); \
		ZB_AF_DECLARE_ENDPOINT_DESC(ep_name, ep_id, ZB_AF_HA_PROFILE_ID, 0, NULL,     \
		ZB_ZCL_ARRAY_SIZE(cluster_list, zb_zcl_cluster_desc_t), cluster_list, \
			(zb_af_simple_desc_1_1_t *)&simple_desc_##ep_name, \
0, NULL, /* No reporting ctx */ \
0, NULL) 
```
